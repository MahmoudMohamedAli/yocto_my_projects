## meta-services/conf/layer.conf
```bitbake
# We have a conf and classes directory, add to BBPATH
BBPATH .= ":${LAYERDIR}"

# We have recipes-* directories, add to BBFILES
BBFILES += "${LAYERDIR}/recipes-*/*/*.bb \
            ${LAYERDIR}/recipes-*/*/*.bbappend"

BBFILE_COLLECTIONS += "meta-services"
BBFILE_PATTERN_meta-services = "^${LAYERDIR}/"
BBFILE_PRIORITY_meta-services = "6"

LAYERDEPENDS_meta-services = "core"
LAYERSERIES_COMPAT_meta-services = "kirkstone"
```
